// SPDX-License-Identifier: (GPL-2.0+ OR MIT)
/*
 * Copyright (c) 2020 Hardkernel Co., Ltd
 */

/dts-v1/;
#include "rk3326-r36s-android.dtsi"


&dsi {
	panel@0 {
		panel-init-sequence = [
			15 00 02 FF 30
			15 00 02 FF 52
			15 00 02 FF 01
			15 00 02 E3 00
			15 00 02 25 10
			15 00 02 28 6f
			15 00 02 29 01
			15 00 02 2A df
			15 00 02 2C 22
			15 00 02 C3 0f
			15 00 02 37 9c
			15 00 02 38 a7
			15 00 02 39 41
			15 00 02 80 20
			15 00 02 91 67
			15 00 02 92 67
			15 00 02 a0 55
			15 00 02 a1 50
			15 00 02 A3 58
			15 00 02 A4 9c
			15 00 02 A7 02
			15 00 02 A8 01
			15 00 02 A9 21
			15 00 02 AA fc
			15 00 02 AB 28
			15 00 02 AC 06
			15 00 02 AD 06
			15 00 02 AE 06
			15 00 02 AF 03
			15 00 02 B0 08
			15 00 02 B1 26
			15 00 02 B2 28
			15 00 02 B3 28
			15 00 02 B4 03
			15 00 02 B5 08
			15 00 02 B6 26
			15 00 02 B7 08
			15 00 02 B8 26
			15 00 02 2C 22
			15 00 02 5C 40
			15 00 02 C0 00
			15 00 02 C1 00
			15 00 02 C2 00
			15 00 02 FF 30
			15 00 02 FF 52
			15 00 02 FF 02
			15 00 02 B0 02
			15 00 02 D0 02
			15 00 02 B1 0f
			15 00 02 D1 10
			15 00 02 B2 11
			15 00 02 D2 12
			15 00 02 B3 32
			15 00 02 D3 33
			15 00 02 B4 36
			15 00 02 D4 36
			15 00 02 B5 3c
			15 00 02 D5 3c
			15 00 02 B6 20
			15 00 02 D6 20
			15 00 02 B7 3e
			15 00 02 D7 3e
			15 00 02 B8 0e
			15 00 02 d8 0d
			15 00 02 b9 05
			15 00 02 d9 05
			15 00 02 ba 11
			15 00 02 da 12
			15 00 02 bb 11
			15 00 02 db 11
			15 00 02 bc 13
			15 00 02 dc 14
			15 00 02 bd 14
			15 00 02 dd 14
			15 00 02 be 16
			15 00 02 de 18
			15 00 02 bf 0e
			15 00 02 df 0f
			15 00 02 c0 17
			15 00 02 e0 17
			15 00 02 c1 07
			15 00 02 e1 08
			15 00 02 ff 30
			15 00 02 ff 52
			15 00 02 ff 03
			15 00 02 08 8a
			15 00 02 09 8b
			15 00 02 30 00
			15 00 02 31 00
			15 00 02 32 00
			15 00 02 33 00
			15 00 02 34 61
			15 00 02 35 d4
			15 00 02 36 24
			15 00 02 37 03
			15 00 02 40 86
			15 00 02 41 87
			15 00 02 42 84
			15 00 02 43 85
			15 00 02 44 11
			15 00 02 45 de
			15 00 02 46 dd
			15 00 02 47 11
			15 00 02 48 e0
			15 00 02 49 df
			15 00 02 50 82
			15 00 02 51 83
			15 00 02 52 80
			15 00 02 53 81
			15 00 02 54 11
			15 00 02 55 e2
			15 00 02 56 e1
			15 00 02 57 11
			15 00 02 58 e4
			15 00 02 59 e3
			15 00 02 82 0f
			15 00 02 83 0f
			15 00 02 84 00
			15 00 02 85 0f
			15 00 02 86 0f
			15 00 02 87 0e
			15 00 02 88 0e
			15 00 02 89 06
			15 00 02 8a 06
			15 00 02 8b 07
			15 00 02 8c 07
			15 00 02 8d 04
			15 00 02 8e 04
			15 00 02 8f 05
			15 00 02 90 05
			15 00 02 98 0f
			15 00 02 99 0f
			15 00 02 9a 00
			15 00 02 9b 0f
			15 00 02 9c 0f
			15 00 02 9d 0e
			15 00 02 9e 0e
			15 00 02 9f 06
			15 00 02 a0 06
			15 00 02 a1 07
			15 00 02 a2 07
			15 00 02 a3 04
			15 00 02 a4 04
			15 00 02 a5 05
			15 00 02 a6 05
			15 00 02 e0 02
			15 00 02 e1 52
			15 00 02 ff 30
			15 00 02 ff 52
			15 00 02 ff 00
			15 00 02 36 02
			15 00 02 11 00
			15 00 02 29 00
			05 c8 01 11
			05 14 01 29
		];
	};
};

&status_led {
	status = "okay";
};
