// SPDX-License-Identifier: (GPL-2.0+ OR MIT)
/*
 * EXPERIMENTAL - not tested on hardware by andr36oid. Keep a copy of the files
 * you replace so you can go back.
 *
 * A genuine R36S board whose screen was replaced with a different 640x480 DSI
 * panel (a Himax-class "Panel 4 Type 1" screen that this model doesn't normally
 * ship with). Same board wiring as a normal R36S - only the panel differs, so
 * this reuses the R36S base and swaps the panel init, timing and delays.
 * Transplanted from the working dArkOSEn and ArkOS4Clone device trees for this
 * exact screen (both carry an identical panel).
 */

/dts-v1/;
#include "rk3326-r36s-android.dtsi"

&dsi {
	panel@0 {
		prepare-delay-ms = <100>;
		reset-delay-ms = <50>;
		init-delay-ms = <20>;
		enable-delay-ms = <200>;
		disable-delay-ms = <50>;
		unprepare-delay-ms = <250>;
		dsi,flags = <(MIPI_DSI_MODE_VIDEO |
		      MIPI_DSI_MODE_VIDEO_BURST |
		      MIPI_DSI_MODE_EOT_PACKET |
		      MIPI_DSI_MODE_LPM)>;
		panel-init-sequence = [
			39 00 04 b9 f1 12 87 39 00 04 b2 78 04 70 39
			00 0b b3 10 10 fc fc 03 ff 00 00 00 00 15 00
			02 b4 80 39 00 03 b5 0f 0f 39 00 03 b6 70 70
			39 00 05 b8 26 22 f0 13 39 00 1c ba 33 81 05
			f9 0e 0e 20 00 00 00 00 00 00 00 44 25 00 91
			0a 00 00 01 4f 01 00 00 37 15 00 02 bc 47 39
			00 06 bf 02 11 00 80 04 39 00 0a c0 73 73 50
			50 00 00 12 73 00 39 00 12 c1 73 00 32 32 77
			f4 77 77 cc cc ff ff 11 11 00 00 32 39 00 0d
			c7 b8 00 0a 10 01 09 00 00 ed c5 00 a5 39 00
			05 c8 10 40 1e 03 15 00 02 cc 0b 39 00 23 e0
			00 05 09 29 3c 3f 3b 37 05 0a 0c 10 13 10 13
			12 1a 00 05 09 29 3c 3f 3b 37 05 0a 0c 10 13
			10 13 12 1a 39 00 08 e1 11 11 91 00 00 00 00
			39 00 0f e3 07 07 0b 0b 0b 0b 00 00 00 00 ff
			04 c0 10 39 00 40 e9 c8 10 02 00 00 b0 b1 11
			31 23 28 80 b0 b1 27 08 00 04 02 00 00 00 00
			04 02 00 00 00 88 88 ba 60 24 08 88 88 88 88
			88 88 88 ba 71 35 18 88 88 88 88 88 00 00 00
			01 00 00 00 00 00 00 00 00 00 39 00 3e ea 97
			0a 82 02 03 07 00 00 00 00 00 00 81 88 ba 17
			53 88 88 88 88 88 88 80 88 ba 06 42 88 88 88
			88 88 88 23 00 00 02 a5 00 00 00 00 00 00 00
			00 00 00 00 00 00 00 00 00 00 00 00 00 00 00
			39 00 04 ef ff ff 01 05 fa 01 11 05 32 01 29
		];
		panel-exit-sequence = [
			05 78 01 28
			05 78 01 10
		];
	};
};

/* The replacement panel's native 640x480 timing (40 MHz pixel clock). */
&timing0 {
	clock-frequency = <40000000>;
	hactive = <640>;
	vactive = <480>;
	hfront-porch = <46>;
	hsync-len = <2>;
	hback-porch = <44>;
	vfront-porch = <16>;
	vsync-len = <2>;
	vback-porch = <14>;
	hsync-active = <0>;
	vsync-active = <0>;
	de-active = <0>;
	pixelclk-active = <0>;
};

&status_led {
	status = "okay";
};
