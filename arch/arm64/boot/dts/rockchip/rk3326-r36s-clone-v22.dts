// SPDX-License-Identifier: (GPL-2.0+ OR MIT)
/*
 * EXPERIMENTAL - not tested on hardware by andr36oid. Keep a copy of the
 * files you replace so you can go back.
 *
 * R36S-V22 (2024-12-18), HL-R36H-V21 (2024-11-18), R36XX-V21 (2024-12-18).
 * Board wiring as the genuine R36S; only the panel differs.
 * Source: dArkOSRE ports by southoz (dArkOSRE-R36, r36s/).
 */

/dts-v1/;
#include "rk3326-r36s-android.dtsi"
#include "rk3326-r36s-clone-panel-v22.dtsi"

/ {
	model = "R36S-V22 (experimental)";
};

/* the R36S status LED: a V21/V22 is an R36S board revision */
&status_led {
	status = "okay";
};
