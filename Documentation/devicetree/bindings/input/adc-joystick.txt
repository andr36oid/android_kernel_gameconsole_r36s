## Documentation/devicetree/bindings/input/adc-joystick.txt
```
Direct ADC joystick

Required properties:
- compatible: "adc-joystick"
- io-channels: two IIO voltage channels, X then Y
- io-channel-names: "joy_x", "joy_y"

Optional properties:
- label: input device name
- linux,abs-codes: two distinct Linux ABS event codes, each <= ABS_MAX.
  Defaults to ABS_X, ABS_Y. Use ABS_RX, ABS_RY for a right stick.
- poll-interval: milliseconds, defaults to 500
- report-threshold: minimum change in millivolts, defaults to 2
- report-x-min, report-y-min: minimum axis values, defaults to 0
- report-x-max, report-y-max: maximum axis values, defaults to 1800

Example:

right-stick {
	compatible = "adc-joystick";
	label = "right stick";
	io-channels = <&saradc 2>, <&saradc 3>;
	io-channel-names = "joy_x", "joy_y";
	linux,abs-codes = <ABS_RX ABS_RY>;
	poll-interval = <30>;
};
```

## drivers/net/wireless/seekwave/sv6160/Kconfig
```kconfig
config SV6160
	tristate "Seekwave SV6160 / Rockchip RK915 SDIO WiFi"
	depends on MAC80211 && MMC
	depends on ARM64 || COMPILE_TEST
	select FW_LOADER
	help
	  Experimental mac80211 driver for Seekwave SV6160 (Rockchip RK915).
	  Firmware loading and SDIO transport are implemented upstream;
	  scanning, association and data traffic still need hardware validation.
	  This driver does not implement Bluetooth.
	  The module is called sv6160.
```
